## app/build/Kconfig/Kconfig.modules
```kconfig
menu "Amy-s-eie_nrf52840.git (C:/Users/activ/zephyr-projects/Amy-s-eie_nrf52840.git)"
osource "C:/Users/activ/zephyr-projects/Amy-s-eie_nrf52840.git/Kconfig"
config ZEPHYR_AMY_S_EIE_NRF52840_GIT_MODULE
	bool
	default y
endmenu
menu "cmsis_6 (C:/Users/activ/zephyr-projects/modules/hal/cmsis_6)"
osource "$(ZEPHYR_CMSIS_6_KCONFIG)"
config ZEPHYR_CMSIS_6_MODULE
	bool
	default y
endmenu
menu "hal_nordic (C:/Users/activ/zephyr-projects/modules/hal/nordic)"
osource "$(ZEPHYR_HAL_NORDIC_KCONFIG)"
config ZEPHYR_HAL_NORDIC_MODULE
	bool
	default y

config ZEPHYR_HAL_NORDIC_MODULE_BLOBS
	bool
endmenu
```

## app/build/Kconfig/boards/Kconfig
```kconfig
# Load Zephyr board Kconfig descriptions.
osource "C:/Users/activ/zephyr-projects/zephyr/boards/nordic/nrf52840dk/Kconfig"
```

## app/build/Kconfig/boards/Kconfig.defconfig
```kconfig
# Load Zephyr board defconfig descriptions.
osource "C:/Users/activ/zephyr-projects/zephyr/boards/nordic/nrf52840dk/Kconfig.defconfig"
```
